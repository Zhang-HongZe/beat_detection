## Kconfig
```kconfig
menu "Beat Detection Configuration"

    config BEAT_DETECTION_THRESHOLD
        int "Bass surge detection threshold (multiplied by 10)"
        range 10 1000
        default 60
        help
            Threshold for bass surge detection. The actual value is this number divided by 10.
            For example, 60 means 6.0.
            Range: 10-1000 (1.0 to 100.0)

    config BEAT_DETECTION_AVERAGE_RATIO
        int "Average ratio threshold (multiplied by 10)"
        range 10 1000
        default 50
        help
            Average ratio threshold for beat detection. The actual value is this number divided by 10.
            For example, 50 means 5.0.
            Range: 10-1000 (1.0 to 100.0)

    config BEAT_DETECTION_MIN_ENERGY
        int "Minimum energy threshold (multiplied by 1000)"
        range 1 10000
        default 10
        help
            Minimum energy threshold for beat detection. The actual value is this number divided by 1000.
            For example, 10 means 0.01.
            Range: 1-10000 (0.001 to 10.0)

    config BEAT_DETECTION_TIME_INTERVAL
        int "Time interval between beat detections (ms)"
        range 10 10000
        default 100
        help
            Minimum time interval in milliseconds between consecutive beat detections.
            Range: 10-10000 ms

endmenu
```
